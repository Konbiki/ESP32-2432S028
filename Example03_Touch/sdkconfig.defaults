## Example03_Touch/sdkconfig.defaults
```kconfig
; PSRAM enable
CONFIG_SPIRAM=y
CONFIG_SPIRAM_IGNORE_NOTFOUND=y

; CPU speed
CONFIG_ESP_DEFAULT_CPU_FREQ_MHZ_240=y
CONFIG_ESP_DEFAULT_CPU_FREQ_MHZ=240
```

## Example04_TouchAndLCD/sdkconfig.defaults
```kconfig
; PSRAM enable
CONFIG_SPIRAM=y
CONFIG_SPIRAM_IGNORE_NOTFOUND=y

; CPU speed
CONFIG_ESP_DEFAULT_CPU_FREQ_MHZ_240=y
CONFIG_ESP_DEFAULT_CPU_FREQ_MHZ=240

; Long file name
;CONFIG_FATFS_LFN_STACK=y
;CONFIG_FATFS_MAX_LFN=255

; Japanese file name
;CONFIG_FATFS_API_ENCODING_UTF_8=y
;CONFIG_FATFS_CODEPAGE_932=y
;CONFIG_FATFS_CODEPAGE=932
```
